## build/Vitals_monitoring_system/Kconfig/boards/Kconfig
```kconfig
# Load Zephyr board Kconfig descriptions.
osource "C:/ncs/v2.9.1/zephyr/boards/nordic/nrf52dk/Kconfig"
```

## build/Vitals_monitoring_system/Kconfig/boards/Kconfig.defconfig
```kconfig
# Load Zephyr board defconfig descriptions.
osource "C:/ncs/v2.9.1/zephyr/boards/nordic/nrf52dk/Kconfig.defconfig"
```
